## conf/distro/dj-ctrl-weston.conf
```bitbake
# Base on ST's distro
require conf/distro/openstlinux-weston.conf

DISTRO = "dj-ctrl-weston"
DISTRO_NAME = "DJ Controller OpenSTLinux Weston"
DISTRO_VERSION = "1.0"

# QT_FORCE_BUILD_TOOLS = "ON"

# TOOLCHAIN_TARGET_TASK:append = " \
#     qtbase-tools \
#     qtdeclarative-tools \
# "

# TOOLCHAIN_HOST_TASK:append = " \
#     nativesdk-qtbase \
#     nativesdk-qtbase-dev \
#     nativesdk-qtbase-tools \
#     nativesdk-qttools \
#     nativesdk-qtdeclarative \
#     nativesdk-qtdeclarative-tools \
# "

# # Explicitly exclude examples from SDK
# TOOLCHAIN_TARGET_TASK:remove = " \
#     qtbase-examples \
#     qtbase-dev-examples \
#     qtdeclarative-examples \
#     qtdeclarative-dev-examples \
# "

# # And prevent -dev packages from dragging in examples cmake files
# PACKAGECONFIG:remove:pn-qtbase = "examples"
# PACKAGECONFIG:remove:pn-qtdeclarative = "examples"

DISTRO_FEATURES:remove = "connman"
DISTRO_FEATURES:append = " networkmanager"

PACKAGE_EXCLUDE += "connman connman-client"

TOOLCHAIN_TARGET_TASK:append = " \
    networkmanager-qt \
    networkmanager-qt-dev \
"

TOOLCHAIN_TARGET_TASK:remove = " \
    packagegroup-qt6-modules \
    packagegroup-qt6-addons \
    qtdeviceutilities \
    libqt6networksettings6 \
"
```
